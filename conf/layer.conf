## conf/layer.conf
```bitbake
# Copyright (C) 2025 PHYTEC Messtechnik GmbH,
# Author: Martin Podolszki <m.podolszki@phytec.de>

BBPATH .= ":${LAYERDIR}"

BBFILES += "${LAYERDIR}/recipes-*/*/*.bb \
            ${LAYERDIR}/recipes-*/*/*.bbappend"

BBFILE_COLLECTIONS += "kinaraara2"
BBFILE_PATTERN_kinaraara2 = "^${LAYERDIR}/"
BBFILE_PRIORITY_kinaraara2 = "7"
LAYERSERIES_COMPAT_kinaraara2 = "scarthgap"
```
